// This file is automatically generated.
// define memory with size = 4G;
define region extended_boot_reserved = [from 0x22000000 size 0x00011000];
define region extended_boot_reserved_C = [from 0x02000000 size 0x00011000];
define region extended_boot_reserved_C_S = [from 0x12000000 size 0x00011000];
define region extended_boot_reserved_S = [from 0x32000000 size 0x00011000];
define region m33s_keys = [from 0x22011000 size 0x00019000];
define region m33s_keys_C = [from 0x02011000 size 0x00019000];
define region m33s_keys_C_S = [from 0x12011000 size 0x00019000];
define region m33s_keys_S = [from 0x32011000 size 0x00019000];
define region reserved_region = [from 0x2206A000 size 0x00016000];
define region reserved_region_C = [from 0x0206A000 size 0x00016000];
define region reserved_region_C_S = [from 0x1206A000 size 0x00016000];
define region reserved_region_S = [from 0x3206A000 size 0x00016000];
define region m33s_nvm = [from 0x60100000 size 0x00240000];
define region m33s_nvm_C = [from 0x08100000 size 0x00240000];
define region m33s_nvm_C_S = [from 0x18100000 size 0x00240000];
define region m33s_nvm_S = [from 0x70100000 size 0x00240000];
define region m33s_system_shared = [from 0x24000000 size 0x00002000];
define region m33s_system_shared_C = [from 0x04000000 size 0x00002000];
define region m33s_system_shared_C_S = [from 0x14000000 size 0x00002000];
define region m33s_system_shared_S = [from 0x34000000 size 0x00002000];
define region m33s_code = [from 0x24002000 size 0x00007000];
define region m33s_code_C = [from 0x04002000 size 0x00007000];
define region m33s_code_C_S = [from 0x14002000 size 0x00007000];
define region m33s_code_S = [from 0x34002000 size 0x00007000];
define region m33s_data = [from 0x24009000 size 0x0004B000];
define region m33s_data_C = [from 0x04009000 size 0x0004B000];
define region m33s_data_C_S = [from 0x14009000 size 0x0004B000];
define region m33s_data_S = [from 0x34009000 size 0x0004B000];
define region m33_nsc = [from 0x24054000 size 0x00001000];
define region m33_nsc_C = [from 0x04054000 size 0x00001000];
define region m33_nsc_C_S = [from 0x14054000 size 0x00001000];
define region m33_nsc_S = [from 0x34054000 size 0x00001000];
define region m33_m55_system_shared = [from 0x240FD000 size 0x00003000];
define region m33_m55_system_shared_C = [from 0x040FD000 size 0x00003000];
define region m33_m55_system_shared_C_S = [from 0x140FD000 size 0x00003000];
define region m33_m55_system_shared_S = [from 0x340FD000 size 0x00003000];
