// This file is automatically generated.
// define memory with size = 4G;
define region m55_data_INTERNAL = [from 0x20000000 size 0x00040000];
define region m55_code_INTERNAL = [from 0x00000000 size 0x00040000];
define region m55_nvm = [from 0x60580000 size 0x002FFC00];
define region m55_code2 = [from 0x26000000 size 0x00040000];
define region gfx_mem = [from 0x26060800 size 0x00300000];
define region m33_m55_shared = [from 0x26360800 size 0x0001F800];
define region m55_data2 = [from 0x26380000 size 0x00180000];
define region m33_m55_system_shared = [from 0x240FD000 size 0x00003000];
