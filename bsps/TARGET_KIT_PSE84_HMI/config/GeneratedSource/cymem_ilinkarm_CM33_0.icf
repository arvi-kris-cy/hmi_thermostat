// This file is automatically generated.
define exported symbol CYMEM_CM33_0_m55_data_START = 0x48040000;
define exported symbol CYMEM_CM33_0_m55_data_SIZE = 0x00040000;
define exported symbol CYMEM_CM33_0_m55_data_OFFSET = 0x00000000;
define exported symbol CYMEM_CM33_0_m55_data_sel_START = CYMEM_CM33_0_m55_data_START;
define exported symbol CYMEM_CM33_0_m55_code_START = 0x48000000;
define exported symbol CYMEM_CM33_0_m55_code_SIZE = 0x00040000;
define exported symbol CYMEM_CM33_0_m55_code_OFFSET = 0x00000000;
define exported symbol CYMEM_CM33_0_m55_code_sel_START = CYMEM_CM33_0_m55_code_START;
define exported symbol CYMEM_CM33_0_user_programmable_START = 0x22011000;
define exported symbol CYMEM_CM33_0_user_programmable_C_START = 0x02011000;
define exported symbol CYMEM_CM33_0_user_programmable_SIZE = 0x00019000;
define exported symbol CYMEM_CM33_0_user_programmable_OFFSET = 0x00011000;
define exported symbol CYMEM_CM33_0_user_programmable_sel_START = CYMEM_CM33_0_user_programmable_C_START;
define exported symbol CYMEM_CM33_0_user_nvm_START = 0x2202A000;
define exported symbol CYMEM_CM33_0_user_nvm_C_START = 0x0202A000;
define exported symbol CYMEM_CM33_0_user_nvm_SIZE = 0x00040000;
define exported symbol CYMEM_CM33_0_user_nvm_OFFSET = 0x0002A000;
define exported symbol CYMEM_CM33_0_user_nvm_sel_START = CYMEM_CM33_0_user_nvm_C_START;
define exported symbol CYMEM_CM33_0_m33s_nvm_START = 0x60100000;
define exported symbol CYMEM_CM33_0_m33s_nvm_C_START = 0x08100000;
define exported symbol CYMEM_CM33_0_m33s_nvm_SIZE = 0x00240000;
define exported symbol CYMEM_CM33_0_m33s_nvm_OFFSET = 0x00100000;
define exported symbol CYMEM_CM33_0_m33s_nvm_sel_START = CYMEM_CM33_0_m33s_nvm_C_START;
define exported symbol CYMEM_CM33_0_m33s_trailer_START = 0x60340000;
define exported symbol CYMEM_CM33_0_m33s_trailer_C_START = 0x08340000;
define exported symbol CYMEM_CM33_0_m33s_trailer_SIZE = 0x00040000;
define exported symbol CYMEM_CM33_0_m33s_trailer_OFFSET = 0x00340000;
define exported symbol CYMEM_CM33_0_m33s_trailer_sel_START = CYMEM_CM33_0_m33s_trailer_C_START;
define exported symbol CYMEM_CM33_0_m33_nvm_START = 0x60380000;
define exported symbol CYMEM_CM33_0_m33_nvm_C_START = 0x08380000;
define exported symbol CYMEM_CM33_0_m33_nvm_SIZE = 0x00240000;
define exported symbol CYMEM_CM33_0_m33_nvm_OFFSET = 0x00380000;
define exported symbol CYMEM_CM33_0_m33_nvm_sel_START = CYMEM_CM33_0_m33_nvm_C_START;
define exported symbol CYMEM_CM33_0_m33_trailer_START = 0x605C0000;
define exported symbol CYMEM_CM33_0_m33_trailer_C_START = 0x085C0000;
define exported symbol CYMEM_CM33_0_m33_trailer_SIZE = 0x00040000;
define exported symbol CYMEM_CM33_0_m33_trailer_OFFSET = 0x005C0000;
define exported symbol CYMEM_CM33_0_m33_trailer_sel_START = CYMEM_CM33_0_m33_trailer_C_START;
define exported symbol CYMEM_CM33_0_m55_nvm_START = 0x60600000;
define exported symbol CYMEM_CM33_0_m55_nvm_C_START = 0x08600000;
define exported symbol CYMEM_CM33_0_m55_nvm_SIZE = 0x00880000;
define exported symbol CYMEM_CM33_0_m55_nvm_OFFSET = 0x00600000;
define exported symbol CYMEM_CM33_0_m55_nvm_sel_START = CYMEM_CM33_0_m55_nvm_C_START;
define exported symbol CYMEM_CM33_0_m55_trailer_START = 0x60E80000;
define exported symbol CYMEM_CM33_0_m55_trailer_C_START = 0x08E80000;
define exported symbol CYMEM_CM33_0_m55_trailer_SIZE = 0x00040000;
define exported symbol CYMEM_CM33_0_m55_trailer_OFFSET = 0x00E80000;
define exported symbol CYMEM_CM33_0_m55_trailer_sel_START = CYMEM_CM33_0_m55_trailer_C_START;
define exported symbol CYMEM_CM33_0_m55_code_secondary_START = 0x26000000;
define exported symbol CYMEM_CM33_0_m55_code_secondary_C_START = 0x06000000;
define exported symbol CYMEM_CM33_0_m55_code_secondary_SIZE = 0x00001000;
define exported symbol CYMEM_CM33_0_m55_code_secondary_OFFSET = 0x00000000;
define exported symbol CYMEM_CM33_0_m55_code_secondary_sel_START = CYMEM_CM33_0_m55_code_secondary_C_START;
define exported symbol CYMEM_CM33_0_m55_data_secondary_START = 0x26001000;
define exported symbol CYMEM_CM33_0_m55_data_secondary_C_START = 0x06001000;
define exported symbol CYMEM_CM33_0_m55_data_secondary_SIZE = 0x002EB000;
define exported symbol CYMEM_CM33_0_m55_data_secondary_OFFSET = 0x00001000;
define exported symbol CYMEM_CM33_0_m55_data_secondary_sel_START = CYMEM_CM33_0_m55_data_secondary_C_START;
define exported symbol CYMEM_CM33_0_m33_m55_shared_START = 0x262EC000;
define exported symbol CYMEM_CM33_0_m33_m55_shared_C_START = 0x062EC000;
define exported symbol CYMEM_CM33_0_m33_m55_shared_SIZE = 0x00001000;
define exported symbol CYMEM_CM33_0_m33_m55_shared_OFFSET = 0x002EC000;
define exported symbol CYMEM_CM33_0_m33_m55_shared_sel_START = CYMEM_CM33_0_m33_m55_shared_C_START;
define exported symbol CYMEM_CM33_0_gfx_mem_START = 0x262ED000;
define exported symbol CYMEM_CM33_0_gfx_mem_C_START = 0x062ED000;
define exported symbol CYMEM_CM33_0_gfx_mem_SIZE = 0x00213000;
define exported symbol CYMEM_CM33_0_gfx_mem_OFFSET = 0x002ED000;
define exported symbol CYMEM_CM33_0_gfx_mem_sel_START = CYMEM_CM33_0_gfx_mem_C_START;
define exported symbol CYMEM_CM33_0_m33s_shared_START = 0x24001000;
define exported symbol CYMEM_CM33_0_m33s_shared_C_START = 0x04001000;
define exported symbol CYMEM_CM33_0_m33s_shared_SIZE = 0x00001000;
define exported symbol CYMEM_CM33_0_m33s_shared_OFFSET = 0x00001000;
define exported symbol CYMEM_CM33_0_m33s_shared_sel_START = CYMEM_CM33_0_m33s_shared_C_START;
define exported symbol CYMEM_CM33_0_m33s_code_START = 0x24002000;
define exported symbol CYMEM_CM33_0_m33s_code_C_START = 0x04002000;
define exported symbol CYMEM_CM33_0_m33s_code_SIZE = 0x00035000;
define exported symbol CYMEM_CM33_0_m33s_code_OFFSET = 0x00002000;
define exported symbol CYMEM_CM33_0_m33s_code_sel_START = CYMEM_CM33_0_m33s_code_C_START;
define exported symbol CYMEM_CM33_0_m33s_data_START = 0x24037000;
define exported symbol CYMEM_CM33_0_m33s_data_C_START = 0x04037000;
define exported symbol CYMEM_CM33_0_m33s_data_SIZE = 0x00021000;
define exported symbol CYMEM_CM33_0_m33s_data_OFFSET = 0x00037000;
define exported symbol CYMEM_CM33_0_m33s_data_sel_START = CYMEM_CM33_0_m33s_data_C_START;
define exported symbol CYMEM_CM33_0_m33_code_START = 0x24058000;
define exported symbol CYMEM_CM33_0_m33_code_C_START = 0x04058000;
define exported symbol CYMEM_CM33_0_m33_code_SIZE = 0x00055000;
define exported symbol CYMEM_CM33_0_m33_code_OFFSET = 0x00058000;
define exported symbol CYMEM_CM33_0_m33_code_sel_START = CYMEM_CM33_0_m33_code_C_START;
define exported symbol CYMEM_CM33_0_m33_data_START = 0x240AD000;
define exported symbol CYMEM_CM33_0_m33_data_C_START = 0x040AD000;
define exported symbol CYMEM_CM33_0_m33_data_SIZE = 0x00050000;
define exported symbol CYMEM_CM33_0_m33_data_OFFSET = 0x000AD000;
define exported symbol CYMEM_CM33_0_m33_data_sel_START = CYMEM_CM33_0_m33_data_C_START;
define exported symbol CYMEM_CM33_0_m33s_allocatable_shared_START = 0x240FD000;
define exported symbol CYMEM_CM33_0_m33s_allocatable_shared_C_START = 0x040FD000;
define exported symbol CYMEM_CM33_0_m33s_allocatable_shared_SIZE = 0x00001000;
define exported symbol CYMEM_CM33_0_m33s_allocatable_shared_OFFSET = 0x000FD000;
define exported symbol CYMEM_CM33_0_m33s_allocatable_shared_sel_START = CYMEM_CM33_0_m33s_allocatable_shared_C_START;
define exported symbol CYMEM_CM33_0_m33_allocatable_shared_START = 0x240FE000;
define exported symbol CYMEM_CM33_0_m33_allocatable_shared_C_START = 0x040FE000;
define exported symbol CYMEM_CM33_0_m33_allocatable_shared_SIZE = 0x00001000;
define exported symbol CYMEM_CM33_0_m33_allocatable_shared_OFFSET = 0x000FE000;
define exported symbol CYMEM_CM33_0_m33_allocatable_shared_sel_START = CYMEM_CM33_0_m33_allocatable_shared_C_START;
define exported symbol CYMEM_CM33_0_m55_allocatable_shared_START = 0x240FF000;
define exported symbol CYMEM_CM33_0_m55_allocatable_shared_C_START = 0x040FF000;
define exported symbol CYMEM_CM33_0_m55_allocatable_shared_SIZE = 0x00001000;
define exported symbol CYMEM_CM33_0_m55_allocatable_shared_OFFSET = 0x000FF000;
define exported symbol CYMEM_CM33_0_m55_allocatable_shared_sel_START = CYMEM_CM33_0_m55_allocatable_shared_C_START;
