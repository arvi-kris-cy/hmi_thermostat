// This file is automatically generated.
// define memory with size = 4G;
define region m33_persist = [from 0x2202A000 size 0x00040000];
define region m33_persist_C = [from 0x0202A000 size 0x00040000];
define region m33_nvm = [from 0x60340000 size 0x00240000];
define region m33_nvm_C = [from 0x08340000 size 0x00240000];
define region gfx_mem = [from 0x26060800 size 0x00300000];
define region gfx_mem_C = [from 0x06060800 size 0x00300000];
define region m33_m55_shared = [from 0x26360800 size 0x0001F800];
define region m33_m55_shared_C = [from 0x06360800 size 0x0001F800];
define region m33s_code = [from 0x24002000 size 0x00007000];
define region m33s_code_C = [from 0x04002000 size 0x00007000];
define region m33_nsc = [from 0x24054000 size 0x00001000];
define region m33_nsc_C = [from 0x04054000 size 0x00001000];
define region m33_code = [from 0x24055000 size 0x00068000];
define region m33_code_C = [from 0x04055000 size 0x00068000];
define region m33_data = [from 0x240BD000 size 0x00040000];
define region m33_data_C = [from 0x040BD000 size 0x00040000];
define region m33_m55_system_shared = [from 0x240FD000 size 0x00003000];
define region m33_m55_system_shared_C = [from 0x040FD000 size 0x00003000];
