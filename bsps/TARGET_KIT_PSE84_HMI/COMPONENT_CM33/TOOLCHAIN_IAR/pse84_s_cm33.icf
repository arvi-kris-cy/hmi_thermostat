/***************************************************************************//**
* \file pse84_s_cm33.icf
* \version 1.0.0
*
* Linker file for the IAR compiler.
*
* The main purpose of the linker script is to describe how the sections in the
* input files should be mapped into the output file, and to control the memory
* layout of the output file.
*
* \note The entry point location starts at 0x14000000. The valid
* application image should be placed there.
*
* \note The linker files included with the PDL template projects must be generic
* and handle all common use cases. Your project may not use every section
* defined in the linker files. In that case you may see warnings during the
* build process. In your project, you can simply comment out or remove the
* relevant code in the linker file.
*
********************************************************************************
* \copyright
* Copyright (c) (2020-2025), Cypress Semiconductor Corporation (an Infineon company) or
* an affiliate of Cypress Semiconductor Corporation.
* SPDX-License-Identifier: Apache-2.0
*
* Licensed under the Apache License, Version 2.0 (the "License");
* you may not use this file except in compliance with the License.
* You may obtain a copy of the License at
*
*     http://www.apache.org/licenses/LICENSE-2.0
*
* Unless required by applicable law or agreed to in writing, software
* distributed under the License is distributed on an "AS IS" BASIS,
* WITHOUT WARRANTIES OR CONDITIONS OF ANY KIND, either express or implied.
* See the License for the specific language governing permissions and
* limitations under the License.
*******************************************************************************/

/* Include the device memory definitions generated by the Device Configurator */
include  "../../config/GeneratedSource/cymem_ilinkarm_CM33_0_S.icf";

/* Define the stack size for the application
  To set stack size in application add makefile ldflags: --config_def APP_MSP_STACK_SIZE=0x00000800 */
if (!isdefinedsymbol(APP_MSP_STACK_SIZE))
{
  /* default stack size */
  define symbol APP_MSP_STACK_SIZE = 0x00000800;
}
define symbol __ICFEDIT_size_cstack__ = APP_MSP_STACK_SIZE;

/* Defines the minimum heap size. The actual heap size will be expanded to the end of the stack region */
if (!isdefinedsymbol(HEAP_SIZE))
{
  /* default heap size */
  define symbol HEAP_SIZE = 0x00001000;
}
define symbol __ICFEDIT_size_heap__ = HEAP_SIZE;

/* Device definitions */
define symbol VECTORS_ALIGNMENT = 1024;
define memory mem with size = 4G;

/* The size of the MCU boot header area at the start of FLASH */
define symbol MCUBOOT_HEADER_SIZE = 0x400;

/* Include the memory regions generated by the Device Configurator.
  This file contains the memory region definitions for the device,
  which are used to define the memory layout in this linker script. */

include  "../../config/GeneratedSource/cymem_ilinkarm_regions_CM33_0_S.icf";

/* Block definitions */

/* The start address and size of shared memory sub-block in shared memory region for the current core
 * The approach is to have an equal sub-block for each core to avoid shared objects to be overlapped.
 * Default configuration: A sub-block for CM33_S shared data will be 1st.
 */
define symbol CORE_SYSTEM_SHARED_MEM_SIZE   = (CYMEM_CM33_0_S_m33_m55_system_shared_SIZE / 3);
define symbol CORE_SYSTEM_SHARED_MEM_START  = (CYMEM_CM33_0_S_m33_m55_system_shared_S_START);
define region core_shared_memory = [from CORE_SYSTEM_SHARED_MEM_START size CORE_SYSTEM_SHARED_MEM_SIZE];

/* Define a block for performance-sensitive or critical functions that need to be executed in SRAM */
define block RAM_APP with alignment = 8
{
  section .cy_sram0_code,
  section .cy_ramfunc,
  readwrite code object cy_smif.*,
  readwrite code object cy_smif_sfdp.*,
  readwrite code object cy_smif_memslot.*,
  readwrite code object cy_smif_hb_flash.*,
  readwrite code object cy_syslib.*,
  readwrite code object cy_syslib_ext.*,
  readwrite code object cyhal_qspi.*,
  readwrite code object mtb_hal_memoryspi.*,
  readwrite code object mtb_serial_memory.*
};

/* Define the stack and heap blocks */
define block CSTACK with alignment = 8, size = __ICFEDIT_size_cstack__ { };
define block HEAP with expanding size, alignment = 8, minimum size = __ICFEDIT_size_heap__ { };

/* Define the RAM data and bss blocks */
define block RAM_DATA { readwrite section .data };
define block RAM_BSS { readwrite section .bss };
define block RAM_OTHER { readwrite section * };
define block RAM_NOINIT { readwrite section .noinit };
define block RAM with fixed order { block RAM_DATA, block RAM_OTHER, block RAM_NOINIT, block RAM_BSS };

/* Define the RAM vector block */
define block RAM_VECTOR with alignment = VECTORS_ALIGNMENT { section .intvec_ram };

/* Define the veneer code for the Secure APIs block. */
define block NSC with alignment = 4, fixed order {section Veneer$$CMSE};

/* Initialization */
do not initialize { section .noinit, section .intvec_ram };
initialize by copy
{
  readwrite,
  section .cy_sram0_code,
  section .cy_ramfunc,
  readonly object cy_smif.*,
  readonly object cy_smif_sfdp.*,
  readonly object cy_smif_memslot.*,
  readonly object cy_smif_hb_flash.*,
  readonly object cy_syslib.*,
  readonly object cy_syslib_ext.*,
  readonly object cyhal_qspi.*,
  readonly object mtb_hal_memoryspi.*,
  readonly object mtb_serial_memory.*
};

/* Placement */
/* Serial Memory Interface block #0 memory #1, 16 MB */

place at address mem:(CYMEM_CM33_0_S_m33s_nvm_C_S_START + MCUBOOT_HEADER_SIZE) { section .intvec, section .text.cy_os_common };
place in m33s_nvm_C_S { readonly };
place in m33_nsc_C_S { block NSC };

/* SRAM, 1 MB, a piece intended for code placement */
place in m33s_code_S { block RAM_APP };

/* SRAM, 1 MB, a piece intended for data placement */
place at start of m33s_data_S { block RAM_VECTOR };
place in          m33s_data_S { block RAM, block HEAP };
place at end   of m33s_data_S { block CSTACK };

/* SRAM, 1 MB, a piece intended for secure shared RAM memory placement */
place in m33s_system_shared_S { section .cy_sharedmem_sec };

/* SRAM, 1 MB, a piece intended for public shared RAM memory placement */
place in core_shared_memory { section .cy_sharedmem };

keep { section .intvec };
